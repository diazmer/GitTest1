AUTOSAR XML (schema 00046)
package /Diagnostics/Common
  diagnostic contribution set CommonContributionSet: category=DIAGNOSTICS_ECU_EXTRACT, service-tables=New_CDD_ServiceTable
    common-properties dtc-status-availability-mask=57, max-number-of-request-correctly-received-response-pending=30, type-of-dtc-supported=ISO-14229--1, type-of-freeze-frame-record-numeration=CONFIGURED:
      6 x diagnostic debounce algorithm props:
        Timer_10_10_001
          debounce-algorithm:
            diag event debounce time based Timer_10_10_001_TimeBasedAlgorithm: time-failed-threshold=0.01, time-passed-threshold=0.01
        MBC_Default_Counter_Based_Debounce_Algorithm
          debounce-algorithm:
            diag event debounce counter based MBC_Default_Counter_Based_Debounce_Algorithm_CounterBasedAlgorithm: counter-decrement-step-size=1, counter-failed-threshold=127, counter-increment-step-size=1, counter-jump-down=false, counter-jump-down-value=1, counter-jump-up=false, counter-jump-up-value=1, counter-passed-threshold=-128
        Timer_1000_10
          debounce-algorithm:
            diag event debounce time based Timer_1000_10_TimeBasedAlgorithm: time-based-fdc-threshold-storage-value=0, time-failed-threshold=1, time-passed-threshold=0.01
        Timer_3000_10
          debounce-algorithm:
            diag event debounce time based Timer_3000_10_TimeBasedAlgorithm: time-based-fdc-threshold-storage-value=0, time-failed-threshold=3, time-passed-threshold=0.01
        Timer_10_10_002
          debounce-algorithm:
            diag event debounce time based Timer_10_10_002_TimeBasedAlgorithm: time-based-fdc-threshold-storage-value=0, time-failed-threshold=0.01, time-passed-threshold=0.01
        DebounceAlgorithmProps_cf6cdce5
          debounce-algorithm:
            diag event debounce monitor internal DebounceInternalAlgorithm_fd2d4eef
    elements:
      AP_All
      Aging_415ab42e
      ClearDiagnosticInformationClass
      ClearDiagInfo
      ActiveDiagnosticInformation
      HardwareSupplier
      New_IO_Control_1
      New_Present_Values_1
      New_Stored_Data_1
      New_Variant_Coding_1
      DataTransferClass
      File_Transfer_Transmit
      New_CDD_Properties
      EnableConditionGroup_cfd24d47
      SC1_Control_DTC_Setting
      SC12_Production_Mode
      SC3_Local_Voltage
      DTC_0x000001_Event
      DTC_0x000001_Event_To_DebounceAlgorithmProperties_Mapping
      DTC_0x000001_Event_To_EnableConditionGroup_Mapping
      DTC_0x000001_Event_To_DEM_POWER_Power_ON_OFF_Cycle_Mapping
      DTC_0x000001_Event_To_StorageConditionGroup_Mapping
      DTC_0x000001_Event_To_DTC_Mapping
      IoControlClass
      New_IO_Control_1_IoCtrl
      PrimaryMemory
      Development_Fault_Memory
      DEM_DRIVE_MODE_PT_Ready_Not_Ready
      DEM_POWER_Power_ON_OFF_Cycle
      ReadDataByIdentifierClass
      ActiveDiagnosticInformation_Read
      HardwareSupplier_Read
      New_IO_Control_1_ControlStatus
      New_Present_Values_1_Read
      New_Stored_Data_1_Read
      New_Variant_Coding_1_Read
      ReadDtcInformationClass
      Development_Fault_Memory_ReportDTCByStatusMask
      Development_Fault_Memory_ReportDTCExtendedDataRecordByDtcNbr
      Development_Fault_Memory_ReportDTCSnapshotRecordByDtcNbr
      RDTCBSM
      RDTCEDRBDN
      RDTCFDC
      RDTCSSBDTC
      RNODTCBSM
      RSUPDTC
      RequestDownloadClass
      RequestDownload
      RequestFileTransferClass
      File_Transfer_Read
      RequestUploadClass
      SAR_Data_Request_Upload_SAR_Data_Nbr_1
      RoutineControlClass
      Development_Fault_Memory
      Neu_Asynchronous_Routine
      Neu_Routine_Control
      Neu_Synchronous_Routine
      SAR
      Development_Fault_Memory
      Neu_Asynchronous_Routine
      Neu_Routine_Control
      Neu_Synchronous_Routine
      SAR
      New_CDD_ServiceTable
      StorageConditionGroup_cfd24d47
      SC1_Control_DTC_Setting
      SC12_Production_Mode
      SC3_Local_Voltage
      TransferExitClass
      File_Transfer_Stop
      DtcProperties_2743472d
      DTC_0x000001
      WriteDataByIdentifierClass
      New_Variant_Coding_1_Write
  ecu instance New_CDD
  diagnostic ecu instance props New_CDD_Properties: ecu-instance=New_CDD, obd-support=NO-OBD-SUPPORT
  6 x diagnostic data identifier:
    ActiveDiagnosticInformation: id=61696, did-size=4
      diagnostic-parameter bit-offset=0:
        diagnostic data element Identification: array-size-semantics=FIXED-SIZE, max-number-of-elements=3, base-type=uint8_opaq, compu {identical}
      diagnostic-parameter bit-offset=24:
        diagnostic data element Session: base-type=uint8_opaq, compu {mask 127: 1=Default (BitTableDT_005_Active_Diagnostic_Session_1_Default), mask 127: 2=Programming (BitTableDT_005_Active_Diagnostic_Session_2_Programming), mask 127: 3=Extended (BitTableDT_005_Active_Diagnostic_Session_3_Extended), mask 127: 4=Safety System Diagnostic Session (BitTableDT_005_Active_Diagnostic_Session_4_Safety_System_Diagnostic_Sessi), mask 127: 66=Update (BitTableDT_005_Active_Diagnostic_Session_66_Update), mask 127: 73=StandBy (BitTableDT_005_Active_Diagnostic_Session_73_StandBy)}
    HardwareSupplier: id=61780, did-size=2
      diagnostic-parameter bit-offset=0:
        diagnostic data element Hardware_Supplier_Identification: base-type=uint16_mot, compu {0=Reserved (SupplierList_0_Reserved), 1=Becker (SupplierList_1_Becker), 2=Blaupunkt (SupplierList_2_Blaupunkt), 3=Bosch (SupplierList_3_Bosch), 4=MB (SupplierList_4_MB), 5=HuF (SupplierList_5_HuF), 6=Kammerer (SupplierList_6_Kammerer), 7=Kostal (SupplierList_7_Kostal), 8=Siemens (SupplierList_8_Siemens), 9=Stribel (SupplierList_9_Stribel), 10=MicroHeat (SupplierList_10_MicroHeat), 11=JATCO (SupplierList_11_JATCO), 12=Cummins (SupplierList_12_Cummins), 13=ZF Lenksysteme (SupplierList_13_ZF_Lenksysteme), 14=Nidec Motors & Actuators (SupplierList_14_Nidec_Motors_Actuators), 15=S&T Daewoo (Science & Technology Deawoo) (SupplierList_15_ST_Daewoo_Science_Technology_D), 16=SWF (SupplierList_16_SWF), 17=VDO (SupplierList_17_VDO), 18=Webasto (SupplierList_18_Webasto), 19=Dornier (SupplierList_19_Dornier), 20=TEG (SupplierList_20_TEG), 21=Hella (SupplierList_21_Hella), 22=Lucas (SupplierList_22_Lucas), 23=GKR (SupplierList_23_GKR), 24=MBB (SupplierList_24_MBB), 25=Motometer (SupplierList_25_Motometer), 26=Daimler (SupplierList_26_Daimler), 27=Sanden (SupplierList_27_Sanden), 28=IEE (SupplierList_28_IEE), 29=ASK (SupplierList_29_ASK), 30=U-Shin (SupplierList_30_UShin), 31=Volkswagen (SupplierList_31_Volkswagen), 32=Borg (SupplierList_32_Borg), 33=Temic (SupplierList_33_Temic), 34=Teves (SupplierList_34_Teves), 35=BorgWarner (SupplierList_35_BorgWarner), 36=MED S.P.A (SupplierList_36_MED_SPA), 37=DENSO (SupplierList_37_DENSO), 38=ZF (SupplierList_38_ZF), 39=TRW (SupplierList_39_TRW), 40=Dunlop (SupplierList_40_Dunlop), 41=LUK (SupplierList_41_LUK), 42=Hyundai Autonet (SupplierList_42_Hyundai_Autonet), 43=Freightliner (SupplierList_43_Freightliner), 44=TAKATA-PETRI (SupplierList_44_TAKATAPETRI), 45=Haldex (SupplierList_45_Haldex), 46=Hirschmann (SupplierList_46_Hirschmann), 47=e2v Technology (SupplierList_47_e2v_Technology), 48=Magneti Marelli (SupplierList_48_Magneti_Marelli), 49=DODUCO (SupplierList_49_DODUCO), 50=Alpine (SupplierList_50_Alpine), 51=AMC (AEG Mobile Com.) (SupplierList_51_AMC_AEG_Mobile_Com), 52=Bose (SupplierList_52_Bose), 53=Dasa (SupplierList_53_Dasa), 54=Motorola (SupplierList_54_Motorola), 55=Nokia (SupplierList_55_Nokia), 56=Panasonic (SupplierList_56_Panasonic), 57=APAG (SupplierList_57_APAG), 58=Rialtosoft (SupplierList_58_Rialtosoft), 59=Applicom (SupplierList_59_Applicom), 60=Conti Temic (SupplierList_60_Conti_Temic), 61=Cherry (SupplierList_61_Cherry), 62=TI Automotive (SupplierList_62_TI_Automotive), 63=Kongsberg Automotive (SupplierList_63_Kongsberg_Automotive), 64=Delphi (SupplierList_64_Delphi), 65=Alfmeier (SupplierList_65_Alfmeier), 66=Sidler (SupplierList_66_Sidler), 67=Marquardt (SupplierList_67_Marquardt), 68=Wehrle (SupplierList_68_Wehrle), 69=megamos (SupplierList_69_megamos), 70=ADC (SupplierList_70_ADC), 71=BERU (SupplierList_71_BERU), 72=Valeo (SupplierList_72_Valeo), 73=Magna (SupplierList_73_Magna), 74=Allison (SupplierList_74_Allison), 75=Isringhausen (SupplierList_75_Isringhausen), 76=Grammer (SupplierList_76_Grammer), 77=Funkwerk Dabendorf (SupplierList_77_Funkwerk_Dabendorf), 78=Hella-Behr (SupplierList_78_HellaBehr), 79=Pollak (SupplierList_79_Pollak), 80=AKG (SupplierList_80_AKG), 81=Automotive Lighting (SupplierList_81_Automotive_Lighting), 82=TAG (SupplierList_82_TAG), 83=UNITED PARTS (SupplierList_83_UNITED_PARTS), 84=catem (SupplierList_84_catem), 85=Alge (SupplierList_85_Alge), 86=Pierburg (SupplierList_86_Pierburg), 87=Brusa (SupplierList_87_Brusa), 88=Ecostar (SupplierList_88_Ecostar), 89=XCELLSIS (SupplierList_89_XCELLSIS), 90=Wabco Automotive (SupplierList_90_Wabco_Automotive), 91=Voith (SupplierList_91_Voith), 92=Knorr (SupplierList_92_Knorr), 93=TVI (SupplierList_93_TVI), 94=Stoneridge (SupplierList_94_Stoneridge), 95=Telma (SupplierList_95_Telma), 96=STW (SupplierList_96_STW), 97=Koyo (SupplierList_97_Koyo), 98=Eberspächer (SupplierList_98_Eberspcher), 99=ADVICS (SupplierList_99_ADVICS), 100=OMRON (SupplierList_100_OMRON), 101=Mitsubishi Heavy Industry (SupplierList_101_Mitsubishi_Heavy_Industry), 102=Methode (SupplierList_102_Methode), 103=UNISIAJECS (SupplierList_103_UNISIAJECS), 104=UNISIA JKC Steering Systems (SupplierList_104_UNISIA_JKC_Steering_Systems), 105=AISIN (SupplierList_105_AISIN), 106=Zexel Valeo (SupplierList_106_Zexel_Valeo), 107=Schrader (SupplierList_107_Schrader), 108=Ballard (SupplierList_108_Ballard), 109=Alcoa Fujikura (SupplierList_109_Alcoa_Fujikura), 110=Transtron (SupplierList_110_Transtron), 111=Iteris (SupplierList_111_Iteris), 112=SFT (SupplierList_112_SFT), 113=Kiekert AG (SupplierList_113_Kiekert_AG), 114=Behr (SupplierList_114_Behr), 115=MB Lenkungen (SupplierList_115_MB_Lenkungen), 116=Sachs Automotive (SupplierList_116_Sachs_Automotive), 117=Peiker (SupplierList_117_Peiker), 118=Petri (SupplierList_118_Petri), 119=Autoliv (SupplierList_119_Autoliv), 120=Thien electronic (SupplierList_120_Thien_electronic), 121=Siemens VDO (SupplierList_121_Siemens_VDO), 122=Dornier Consulting GmbH (SupplierList_122_Dornier_Consulting_GmbH), 123=Alps (SupplierList_123_Alps), 124=PREH (SupplierList_124_PREH), 125=Hitachi Unisia (SupplierList_125_Hitachi_Unisia), 126=Hitachi (SupplierList_126_Hitachi), 127=Reserved (SupplierList_127_Reserved), 128=Huntsville (SupplierList_128_Huntsville), 129=Yazaki (SupplierList_129_Yazaki), 130=Lear (SupplierList_130_Lear), 131=Johnson Controls (SupplierList_131_Johnson_Controls), 132=Harman / Becker (SupplierList_132_Harman_Becker), 133=Mitsubishi Electric (SupplierList_133_Mitsubishi_Electric), 134=Tokico USA Inc. (SupplierList_134_Tokico_USA_Inc), 135=Nippon Seiki (NS Intl USA) (SupplierList_135_Nippon_Seiki_NS_Intl_USA), 136=Inalfa (SupplierList_136_Inalfa), 137=Nippon Seiki (SupplierList_137_Nippon_Seiki), 138=GHSP (SupplierList_138_GHSP), 139=Vector (SupplierList_139_Vector), 140=Gentex (SupplierList_140_Gentex), 141=Visteon (SupplierList_141_Visteon), 142=Tochigi Fuji (SupplierList_142_Tochigi_Fuji), 143=Chrysler (SupplierList_143_Chrysler), 144=May and Scofield (SupplierList_144_May_and_Scofield), 145=Mercedes-Benz Hamburg Plant (SupplierList_145_MercedesBenz_Hamburg_Plant), 146=AISIN AW (SupplierList_146_AISIN_AW), 147=TOYODA MACHINE WORKS (SupplierList_147_TOYODA_MACHINE_WORKS), 148=Solectron-Invotronics (SupplierList_148_SolectronInvotronics), 149=Kicker (SupplierList_149_Kicker), 150=American Axle Company (SupplierList_150_American_Axle_Company), 151=GETRAG / Magna Transmission Systems (SupplierList_151_GETRAG_Magna_Transmission_Syst), 152=Promate (SupplierList_152_Promate), 153=ArvinMeritor (SupplierList_153_ArvinMeritor), 154=Autometer (SupplierList_154_Autometer), 155=Valeo Sylvania (SupplierList_155_Valeo_Sylvania), 156=Cobasys (SupplierList_156_Cobasys), 157=Helbako (SupplierList_157_Helbako), 158=Continental (SupplierList_158_Continental), 159=Reserved (SupplierList_159_Reserved), 160=Reserved by MMC (SupplierList_160_Reserved_by_MMC), 161=Reserved by MCC-SMART (SupplierList_161_Reserved_by_MCCSMART), 162=FUSO (SupplierList_162_FUSO), 163=Autokabel (SupplierList_163_Autokabel), 164=Hyundai Mobis (SupplierList_164_Hyundai_Mobis), 165=Festo (SupplierList_165_Festo), 166=Schmidhauser (SupplierList_166_Schmidhauser), 167=Sphere DesignGmbH (SupplierList_167_Sphere_DesignGmbH), 168=Deutsche Accumotive GmbH & Co KG (SupplierList_168_Deutsche_Accumotive_GmbH_Co_KG), 169=BRC Gas Equipment (SupplierList_169_BRC_Gas_Equipment), 170=Delta Energy Systems (SupplierList_170_Delta_Energy_Systems), 171=A123 Systems (SupplierList_171_A123_Systems), 172=Mercedes AMG (SupplierList_172_Mercedes_AMG), 173=Huber Automotive AG (SupplierList_173_Huber_Automotive_AG), 174=Witte Velbert (SupplierList_174_Witte_Velbert), 175=MetaSystem (SupplierList_175_MetaSystem), 176=M/A-COM (SupplierList_176_MACOM), 177=TBK (Tokai Bussan Corp) (SupplierList_177_TBK_Tokai_Bussan_Corp), 178=DDC (SupplierList_178_DDC), 179=3Soft (SupplierList_179_3Soft), 180=MB-Tech (SupplierList_180_MBTech), 181=E-T-A (SupplierList_181_ETA), 182=Ssangyong (SupplierList_182_Ssangyong), 183=Paragon (SupplierList_183_Paragon), 184=ThyssenKrupp (SupplierList_184_ThyssenKrupp), 185=Hoerbiger (SupplierList_185_Hoerbiger), 186=Bang and Olufsen (SupplierList_186_Bang_and_Olufsen), 187=Hughes (SupplierList_187_Hughes), 188=Flextronics (SupplierList_188_Flextronics), 189=Spheros (SupplierList_189_Spheros), 190=Küster ACS (SupplierList_190_Kster_ACS), 191=Kromberg und Schubert (SupplierList_191_Kromberg_und_Schubert), 192=SB LiMotive (SupplierList_192_SB_LiMotive), 193=MAGNA E-Car Systems GmbH & Co OG (SupplierList_193_MAGNA_ECar_Systems_GmbH_Co_OG), 194=SK innovation (SupplierList_194_SK_innovation), 195=Renault (SupplierList_195_Renault), 196=Bury (SupplierList_196_Bury), 197=Digades (SupplierList_197_Digades), 198=Claas (SupplierList_198_Claas), 199=Widmaier (SupplierList_199_Widmaier), 200=Garmin (SupplierList_200_Garmin), 201=Liebherr (SupplierList_201_Liebherr), 202=LAWO (SupplierList_202_LAWO), 203=Poclain Hydraulics Industry (SupplierList_203_Poclain_Hydraulics_Industry), 204=Tesla (SupplierList_204_Tesla), 205=Daimler Plant Mannheim (SupplierList_205_Daimler_Plant_Mannheim), 206=Ametek VIS (SupplierList_206_Ametek_VIS), 207=Phoenix International (SupplierList_207_Phoenix_International), 208=Magna Reman (SupplierList_208_Magna_Reman), 209=IHI (SupplierList_209_IHI), 210=Bitron (SupplierList_210_Bitron), 211=Navis (SupplierList_211_Navis), 212=Casco Schoeller GmbH (SupplierList_212_Casco_Schoeller_GmbH), 213=Tokyo R&D (SupplierList_213_Tokyo_RD), 214=Ortem (SupplierList_214_Ortem), 215=BHTC (SupplierList_215_BHTC), 216=Bergstrom (SupplierList_216_Bergstrom), 217=Daimler TSS (SupplierList_217_Daimler_TSS), 218=LG Electronics (SupplierList_218_LG_Electronics), 219=AML (SupplierList_219_AML), 220=Toyota Industries Corporation (SupplierList_220_Toyota_Industries_Corporation), 221=JTEKT (SupplierList_221_JTEKT), 222=Samsung SDI (SupplierList_222_Samsung_SDI), 223=ITK Engineering AG (SupplierList_223_ITK_Engineering_AG), 224=Kristronics (SupplierList_224_Kristronics), 225=RaPa Rausch&Pausch (SupplierList_225_RaPa_RauschPausch), 226=AKASOL GmbH (SupplierList_226_AKASOL_GmbH), 227=Gigatronik Austria (SupplierList_227_Gigatronik_Austria), 228=Westfalia Automotive (SupplierList_228_Westfalia_Automotive), 229=Mekra-Lang GmbH & Co. KG (SupplierList_229_MekraLang_GmbH_Co_KG), 230=Keboda Technology Co., Ltd. (SupplierList_230_Keboda_Technology_Co_Ltd), 231=Valeo eAutomotive (SupplierList_231_Valeo_eAutomotive), 232=Elektrobit (SupplierList_232_Elektrobit), 233=BEG (SupplierList_233_BEG), 234=Hofer (SupplierList_234_Hofer), 235=Laird GmbH (SupplierList_235_Laird_GmbH), 236=AAM (SupplierList_236_AAM), 237=FMCP (SupplierList_237_FMCP), 238=MBRDI (SupplierList_238_MBRDI), 239=Veoneer (SupplierList_239_Veoneer), 240=XTRONIC GmbH (SupplierList_240_XTRONIC_GmbH), 241=Japan Radio Co., Ltd. (SupplierList_241_Japan_Radio_Co_Ltd), 242=Aptiv (SupplierList_242_Aptiv), 243=BCS Automotive Interface Solutions (SupplierList_243_BCS_Automotive_Interface_Solut), 244=CATL (SupplierList_244_CATL), 245=Brose (SupplierList_245_Brose), 246=Munich Electrification (SupplierList_246_Munich_Electrification), 247=BBAC (SupplierList_247_BBAC), 248=Ficosa (SupplierList_248_Ficosa), 249=MB AMG HPP (SupplierList_249_MB_AMG_HPP), 250=CES (SupplierList_250_CES), 251=Semikron (SupplierList_251_Semikron), 252=Tyco (SupplierList_252_Tyco), 253=MELECS (SupplierList_253_MELECS), 254=Thonburi Energy Storage Manufacturing CO.,LTD (SupplierList_254_Thonburi_Energy_Storage_Manufa), 255=Farasis (SupplierList_255_Farasis), 256=Valmet (SupplierList_256_Valmet), 257=Garrett Advancing Motion (SupplierList_257_Garrett_Advancing_Motion), 258=IMI (SupplierList_258_IMI), 259=Daimler Reman 075 (SupplierList_259_Daimler_Reman_075), 260=BECOM Electronics (SupplierList_260_BECOM_Electronics), 261=Daimler Reman 688 (SupplierList_261_Daimler_Reman_688), 262=Molex (SupplierList_262_Molex), 263=ELDOR (SupplierList_263_ELDOR), 264=Blue Solutions (SupplierList_264_Blue_Solutions), 265=Inmotion Technologies (SupplierList_265_Inmotion_Technologies), 266=Eaton (SupplierList_266_Eaton), 267=Sonceboz (SupplierList_267_Sonceboz), 268=Daimler Plant Jawor (SupplierList_268_Daimler_Plant_Jawor), 269=MOBASE ELECTRONICS (SupplierList_269_MOBASE_ELECTRONICS), 270=MBition (SupplierList_270_MBition), 271=Akebono Brake Industry Co., Ltd (SupplierList_271_Akebono_Brake_Industry_Co_Ltd), 272=Alpitronic (SupplierList_272_Alpitronic), 273=Mercedes-Benz Plant Untertuerkheim (SupplierList_273_MercedesBenz_Plant_Untertuerkh), 274=Vitesco Technologies (SupplierList_274_Vitesco_Technologies), 275=Cojali, S.L. (SupplierList_275_Cojali_SL), 276=Alphée (SupplierList_276_Alphe), 277=KOITO MANUFACTURING CO., LTD. (JP) (SupplierList_277_KOITO_MANUFACTURING_CO_LTD_JP), 278=EVE (SupplierList_278_EVE), 279=Dräxlmaier (SupplierList_279_Drxlmaier), 280=Grupo Antolin (SupplierList_280_Grupo_Antolin), 281=SVI Austria GmbH (SupplierList_281_SVI_Austria_GmbH), 282=Luminar Technologies Inc (SupplierList_282_Luminar_Technologies_Inc), 283=Mercedes-Benz Plant Tuscaloosa (SupplierList_283_MercedesBenz_Plant_Tuscaloosa), 284=DANA (SupplierList_284_DANA), 285=RAFI GmbH & Co.KG (SupplierList_285_RAFI_GmbH_CoKG), 286=Weber Hydraulik GmbH (SupplierList_286_Weber_Hydraulik_GmbH), 287=Wuerth (SupplierList_287_Wuerth), 288=Hanon Systems (SupplierList_288_Hanon_Systems), 289=FuDi Battery (SupplierList_289_FuDi_Battery), 290=SII Technologies GmbH (SupplierList_290_SII_Technologies_GmbH), 291=Daimler Plant Sindelfingen (SupplierList_291_Daimler_Plant_Sindelfingen), 292=Qinghai FinDreams Battery Co., Ltd. (SupplierList_292_Qinghai_FinDreams_Battery_Co_L), 293=Camel (SupplierList_293_Camel), 294=GSYuasa (SupplierList_294_GSYuasa), 295=MAHLE GmbH (SupplierList_295_MAHLE_GmbH), 296=REBO Lighting & Electronics GmbH (SupplierList_296_REBO_Lighting_Electronics_GmbH), 297=AKKA Austria GmbH (SupplierList_297_AKKA_Austria_GmbH), 298=WOORY Industrial Co., Ltd. (SupplierList_298_WOORY_Industrial_Co_Ltd), 299=Saint-Gobain Sekurit (SupplierList_299_SaintGobain_Sekurit), 300=BYD Electric Bus and Truck Hungary LLC (SupplierList_300_BYD_Electric_Bus_and_Truck_Hun), 301=Daimler Greater China ltd. (SupplierList_301_Daimler_Greater_China_ltd), 302=Schaeffler (SupplierList_302_Schaeffler), 303..28669=Reserved (SupplierList_303_Reserved), 28670..28671=Reserved for CVD CDS approach (SupplierList_28670_Reserved_for_CVD_CDS_approach), 28672..32767=Reserved (SupplierList_28672_Reserved), 32768..61437=Reserved for CVD CDS approach (SupplierList_32768_Reserved_for_CVD_CDS_approach), 61438=After Market Supplier (SupplierList_61438_After_Market_Supplier), 61439=Unidentified (SupplierList_61439_Unidentified), 61440..65534=Reserved (SupplierList_61440_Reserved), 65535=Not programmed (SupplierList_65535_Not_programmed)}
    New_IO_Control_1: id=258, did-size=1
      diagnostic-parameter bit-offset=0:
        diagnostic data element CONTROL_STATES: base-type=uint8_opaq, compu {identical}
    New_Present_Values_1: id=257, did-size=1
      diagnostic-parameter bit-offset=0:
        diagnostic data element Neues_Datenobjekt: base-type=uint8_opaq, compu {identical}
    New_Stored_Data_1: id=256, did-size=1
      diagnostic-parameter bit-offset=0:
        diagnostic data element Neues_Datenobjekt: base-type=uint8_opaq, compu {identical}
    New_Variant_Coding_1: id=259, did-size=3
      diagnostic-parameter bit-offset=0:
        diagnostic data element SAR_Data_Storage_Status: array-size-semantics=FIXED-SIZE, max-number-of-elements=3, base-type=uint8_opaq, compu {identical}
package /Diagnostics/Common/CompuMethods
  compu method routineInfo: 0=Routine succesfully completed (routineInfo_0_Routine_succesfully_completed), 1=Routine in progress (routineInfo_1_Routine_in_progress), 2=Routine stopped without results (routineInfo_2_Routine_stopped_without_result), 255=Not supported (routineInfo_255_Not_supported)
package /Diagnostics/Common/DataConstraints
  data constr routineInfo: data-constr-rule=internal-constrs=scale-constr{short-label=undefined_value, lower-limit=3, upper-limit=254}
package /Diagnostics/Common/BaseTypes
  base type uint16_mot: category=FIXED_LENGTH, base-type-size=16, base-type-encoding=NONE, byte-order=big-endian
  base type uint8_opaq: category=FIXED_LENGTH, base-type-size=8, base-type-encoding=NONE, byte-order=opaque
package /Diagnostics/Dem
  diagnostic memory destination primary PrimaryMemory
  diagnostic memory destination user defined Development_Fault_Memory: memory-id=16
package /Diagnostics/Dem/Events
  diagnostic event DTC_0x000001_Event: clear-event-behavior=NO-STATUS-BYTE-CHANGE, event-clear-allowed=ALWAYS, event-failure-cycle-counter-threshold=0, event-kind=SWC, prestorage-freeze-frame=false, recoverable-in-same-operation-cycle=true  # Event with MBC Default settings
package /Diagnostics/Dem/Dtcs
  diagnostic trouble code uds DTC_0x000001: dtc-props=DtcProperties_2743472d, severity=NO-SEVERITY, uds-dtc-value=1
package /Diagnostics/Dem/Mappings
  diagnostic event to debounce algorithm mapping DTC_0x000001_Event_To_DebounceAlgorithmProperties_Mapping: debounce-algorithm=DebounceAlgorithmProps_cf6cdce5, diagnostic-event=DTC_0x000001_Event
  diagnostic event to enable condition group mapping DTC_0x000001_Event_To_EnableConditionGroup_Mapping: diagnostic-event=DTC_0x000001_Event, enable-condition-group=EnableConditionGroup_cfd24d47
  diagnostic event to operation cycle mapping DTC_0x000001_Event_To_DEM_POWER_Power_ON_OFF_Cycle_Mapping: diagnostic-event=DTC_0x000001_Event, operation-cycle=DEM_POWER_Power_ON_OFF_Cycle
  diagnostic event to storage condition group mapping DTC_0x000001_Event_To_StorageConditionGroup_Mapping: diagnostic-event=DTC_0x000001_Event, storage-condition-group=StorageConditionGroup_cfd24d47
  diagnostic event to trouble code uds mapping DTC_0x000001_Event_To_DTC_Mapping: diagnostic-event=DTC_0x000001_Event, trouble-code-uds=DTC_0x000001
package /Diagnostics/Dem/DtcProperties
  diagnostic trouble code props DtcProperties_2743472d: aging-allowed=true, aging=Aging_415ab42e, memory-destination=PrimaryMemory, priority=2, significance=FAULT
package /Diagnostics/Dem/Agings
  diagnostic aging Aging_415ab42e: aging-cycles=DEM_DRIVE_MODE_PT_Ready_Not_Ready, threshold=100
package /Diagnostics/Dem/OperationCycles
  diagnostic operation cycle DEM_DRIVE_MODE_PT_Ready_Not_Ready: cycle-autostart=false, type=OTHER
  diagnostic operation cycle DEM_POWER_Power_ON_OFF_Cycle: cycle-autostart=false, type=POWER
package /Diagnostics/Dem/EnableConditions
  diagnostic enable condition group EnableConditionGroup_cfd24d47: enable-conditions=[SC3_Local_Voltage, SC1_Control_DTC_Setting, SC12_Production_Mode]
  diagnostic enable condition SC1_Control_DTC_Setting: init-value=false
  diagnostic enable condition SC12_Production_Mode: init-value=false
  diagnostic enable condition SC3_Local_Voltage: init-value=false
package /Diagnostics/Dem/StorageConditions
  diagnostic storage condition group StorageConditionGroup_cfd24d47: storage-conditions=[SC3_Local_Voltage, SC1_Control_DTC_Setting, SC12_Production_Mode]
  diagnostic storage condition SC1_Control_DTC_Setting: init-value=false
  diagnostic storage condition SC12_Production_Mode: init-value=false
  diagnostic storage condition SC3_Local_Voltage: init-value=false
package /Diagnostics/Dcm
  5 x diagnostic routine:
    Development_Fault_Memory: id=577
      start Development_Fault_Memory_Read_E_E_Data: access-permission=AP_All
        diagnostic-parameter bit-offset=0:
          diagnostic data element In_DTCRecord: array-size-semantics=FIXED-SIZE, max-number-of-elements=3, base-type=uint8_opaq, compu {identical}
        diagnostic-parameter bit-offset=0:
          diagnostic data element Out_DTCRecord: array-size-semantics=FIXED-SIZE, max-number-of-elements=3, base-type=uint8_opaq, compu {identical}
        diagnostic-parameter bit-offset=24:
          diagnostic data element Parameter: array-size-semantics=VARIABLE-SIZE, max-number-of-elements=32, base-type=uint8_opaq, compu {identical}
    Neu_Asynchronous_Routine: id=514
      request result Neu_Asynchronous_Routine_RequestResults: access-permission=AP_All
        diagnostic-parameter bit-offset=0:
          diagnostic data element routineInfo: base-type=uint8_opaq, compu-method=routineInfo, data-constr=routineInfo
      start Neu_Asynchronous_Routine_Start: access-permission=AP_All
        diagnostic-parameter bit-offset=0:
          diagnostic data element Neues_Datenobjekt: base-type=uint8_opaq, compu {identical}
        diagnostic-parameter bit-offset=0:
          diagnostic data element routineInfo: base-type=uint8_opaq, compu-method=routineInfo, data-constr=routineInfo
      stop Neu_Asynchronous_Routine_Stop: access-permission=AP_All
        diagnostic-parameter bit-offset=0:
          diagnostic data element routineInfo: base-type=uint8_opaq, compu-method=routineInfo, data-constr=routineInfo
    Neu_Routine_Control: id=560
      start Neu_Routine_Control_Start: access-permission=AP_All
        diagnostic-parameter bit-offset=0:
          diagnostic data element Neues_Datenobjekt: base-type=uint8_opaq, compu {identical}
    Neu_Synchronous_Routine: id=513
      start Neu_Synchronous_Routine_Start: access-permission=AP_All
        diagnostic-parameter bit-offset=0:
          diagnostic data element Neues_Datenobjekt: base-type=uint8_opaq, compu {identical}
        diagnostic-parameter bit-offset=0:
          diagnostic data element routineInfo: base-type=uint8_opaq, compu-method=routineInfo, data-constr=routineInfo
    SAR: id=578
      start Erase_SAR_Memory_Start: access-permission=AP_All
  diagnostic service table New_CDD_ServiceTable: ecu-instance=New_CDD, service-instance=[ClearDiagInfo, Development_Fault_Memory_ReportDTCByStatusMask, Development_Fault_Memory_ReportDTCExtendedDataRecordByDtcNbr, Development_Fault_Memory_ReportDTCSnapshotRecordByDtcNbr, RDTCBSM, RDTCEDRBDN, RDTCFDC, RDTCSSBDTC, RNODTCBSM, RSUPDTC, ActiveDiagnosticInformation_Read, HardwareSupplier_Read, New_IO_Control_1_ControlStatus, New_Present_Values_1_Read, New_Stored_Data_1_Read, New_Variant_Coding_1_Read, New_Variant_Coding_1_Write, New_IO_Control_1_IoCtrl, Development_Fault_Memory, Neu_Asynchronous_Routine, Neu_Routine_Control, Neu_Synchronous_Routine, SAR, RequestDownload, SAR_Data_Request_Upload_SAR_Data_Nbr_1, File_Transfer_Transmit, File_Transfer_Stop, File_Transfer_Read]
  diagnostic access permission AP_All
package /Diagnostics/Dcm/ServiceClasses
  diagnostic clear diagnostic information class ClearDiagnosticInformationClass: access-permission-validity=ACCESS-PERMISSION-SERVICE-INSTANCE
  diagnostic data transfer class DataTransferClass: access-permission-validity=ACCESS-PERMISSION-SERVICE-INSTANCE
  diagnostic io control class IoControlClass: access-permission-validity=ACCESS-PERMISSION-SERVICE-INSTANCE
  diagnostic read data by identifier class ReadDataByIdentifierClass: access-permission-validity=ACCESS-PERMISSION-SERVICE-INSTANCE, max-did-to-read=1
  diagnostic read dtc information class ReadDtcInformationClass: access-permission-validity=ACCESS-PERMISSION-SERVICE-INSTANCE
  diagnostic request download class RequestDownloadClass: access-permission-validity=ACCESS-PERMISSION-SERVICE-INSTANCE
  diagnostic request file transfer class RequestFileTransferClass: access-permission-validity=ACCESS-PERMISSION-SERVICE-INSTANCE
  diagnostic request upload class RequestUploadClass: access-permission-validity=ACCESS-PERMISSION-SERVICE-INSTANCE
  diagnostic routine control class RoutineControlClass: access-permission-validity=ACCESS-PERMISSION-SERVICE-INSTANCE
  diagnostic transfer exit class TransferExitClass: access-permission-validity=ACCESS-PERMISSION-SERVICE-INSTANCE
  diagnostic write data by identifier class WriteDataByIdentifierClass: access-permission-validity=ACCESS-PERMISSION-SERVICE-INSTANCE
package /Diagnostics/Dcm/ServiceInstances
  diagnostic clear diagnostic information ClearDiagInfo: access-permission=AP_All, clear-diagnostic-information-class=ClearDiagnosticInformationClass  # <condition Cond_ID="Diagnostic_Bus_Interface" value="CAN | CAN-FD | Flexray | 100BASE-T1 Ethernet | 1000BASE-T1 Ethernet | MOST ">Which Bus interface is used as the main connector for diagnostic access to the ECU</condition> <condition Cond_ID="Diagnostic_Specification" value="2023-09">For ECUs implementing MBDS2023</condition> <condition Cond_ID="Variant" value="Application">ECU is running in application mode</condition> <condition Cond_ID="Fault_Memory" value="Yes | Yes with EE-Data">ECU implements Fault Memory for Production and Aftersales purposes and optionally integrates Engineering Environmental Data (E-E-Data)</condition> <condition Cond_ID="BROP_Level" value="1 | 2 | 3 | 4 | 5 | 6 | 7 | 8 | 9 | 10">Service shall be implemented for listed releases </condition>
  diagnostic data transfer File_Transfer_Transmit: access-permission=AP_All, data-transfer-class=DataTransferClass  # <information Inf_ID="01">The File Transfer Transmit service is used by the external test tool to transfer data either from the external test tool to the ECU (download) or from the ECU to the external test tool (upload).</information> <condition Cond_ID="Diagnostic_Bus_Interface" value="CAN | CAN-FD | LIN | Flexray | 100BASE-T1 Ethernet | 1000BASE-T1 Ethernet | MOST ">Which Bus interface is used as the main connector for diagnostic access to the ECU</condition> <condition Cond_ID="Diagnostic_Specification" value="2023-09">For ECUs implementing MBDS2023</condition> <condition Cond_ID="Variant" value="Application">ECU is running in application mode</condition> <condition Cond_ID="Filesystem" value="Yes">ECU is reprogrammable and supports a file system</condition> <condition Cond_ID="BROP_Level" value="4 | 5 | 6 | 7 | 8 | 9 | 10">Service shall be implemented for listed releases </condition>
  diagnostic io control New_IO_Control_1_IoCtrl: access-permission=AP_All, data-identifier=New_IO_Control_1, freeze-current-state=true, io-control-class=IoControlClass, reset-to-default=true, short-term-adjustment=true
  6 x diagnostic read data by identifier, all with access-permission=AP_All, read-class=ReadDataByIdentifierClass:
    ActiveDiagnosticInformation_Read: data-identifier=ActiveDiagnosticInformation
    HardwareSupplier_Read: data-identifier=HardwareSupplier
    New_IO_Control_1_ControlStatus: data-identifier=New_IO_Control_1
    New_Present_Values_1_Read: data-identifier=New_Present_Values_1
    New_Stored_Data_1_Read: data-identifier=New_Stored_Data_1
    New_Variant_Coding_1_Read: data-identifier=New_Variant_Coding_1
  9 x diagnostic read dtc information, all with access-permission=AP_All, read-dtc-information-class=ReadDtcInformationClass:
    Development_Fault_Memory_ReportDTCByStatusMask: category=REPORT_USER_DEF_MEMORY_DTC_BY_STATUS_MASK  # <condition Cond_ID="Diagnostic_Bus_Interface" value="CAN | CAN-FD | Flexray | 100BASE-T1 Ethernet | 1000BASE-T1 Ethernet | MOST ">Which Bus interface is used as the main connector for diagnostic access to the ECU</condition> <condition Cond_ID="Diagnostic_Specification" value="2023-09">For ECUs implementing MBDS2023</condition> <condition Cond_ID="Variant" value="Application">ECU is running in application mode</condition> <condition Cond_ID="Development_Fault_Memory" value="Yes | Yes with EE-Data">The ECU supports DTCs that are relevant for development and analysis purposes only (located in the secondary fault memory(Development Fault Memory)) and optionally integrates Engineering Environmental Data (E-E-Data)</condition> <condition Cond_ID="BROP_Level" value="6 | 7 | 8 | 9 | 10">Service shall be implemented for listed releases </condition>
    Development_Fault_Memory_ReportDTCExtendedDataRecordByDtcNbr: category=REPORT_USER_DEF_MEMORY_DTC_EXT_DATA_RECORD_BY_DTC_NUMBER  # <condition Cond_ID="Diagnostic_Bus_Interface" value="CAN | CAN-FD | Flexray | 100BASE-T1 Ethernet | 1000BASE-T1 Ethernet | MOST ">Which Bus interface is used as the main connector for diagnostic access to the ECU</condition> <condition Cond_ID="Diagnostic_Specification" value="2023-09">For ECUs implementing MBDS2023</condition> <condition Cond_ID="Variant" value="Application">ECU is running in application mode</condition> <condition Cond_ID="Development_Fault_Memory" value="Yes | Yes with EE-Data">The ECU supports DTCs that are relevant for development and analysis purposes only (located in the secondary fault memory(Development Fault Memory)) and optionally integrates Engineering Environmental Data (E-E-Data)</condition> <condition Cond_ID="BROP_Level" value="6 | 7 | 8 | 9 | 10">Service shall be implemented for listed releases </condition>
    Development_Fault_Memory_ReportDTCSnapshotRecordByDtcNbr: category=REPORT_USER_DEF_MEMORY_DTC_SNAPSHOT_RECORD_BY_DTC_NUMBER  # <condition Cond_ID="Diagnostic_Bus_Interface" value="CAN | CAN-FD | Flexray | 100BASE-T1 Ethernet | 1000BASE-T1 Ethernet | MOST ">Which Bus interface is used as the main connector for diagnostic access to the ECU</condition> <condition Cond_ID="Diagnostic_Specification" value="2023-09">For ECUs implementing MBDS2023</condition> <condition Cond_ID="Variant" value="Application">ECU is running in application mode</condition> <condition Cond_ID="Development_Fault_Memory" value="Yes | Yes with EE-Data">The ECU supports DTCs that are relevant for development and analysis purposes only (located in the secondary fault memory(Development Fault Memory)) and optionally integrates Engineering Environmental Data (E-E-Data)</condition> <condition Cond_ID="BROP_Level" value="6 | 7 | 8 | 9 | 10">Service shall be implemented for listed releases </condition>
    RDTCBSM: category=REPORT_DTC_BY_STATUS_MASK  # <condition Cond_ID="Diagnostic_Bus_Interface" value="CAN | CAN-FD | Flexray | 100BASE-T1 Ethernet | 1000BASE-T1 Ethernet | MOST ">Which Bus interface is used as the main connector for diagnostic access to the ECU</condition> <condition Cond_ID="Diagnostic_Specification" value="2023-09">For ECUs implementing MBDS2023</condition> <condition Cond_ID="Variant" value="Application">ECU is running in application mode</condition> <condition Cond_ID="Fault_Memory" value="Yes | Yes with EE-Data">ECU implements Fault Memory for Production and Aftersales purposes and optionally integrates Engineering Environmental Data (E-E-Data)</condition> <condition Cond_ID="BROP_Level" value="1 | 2 | 3 | 4 | 5 | 6 | 7 | 8 | 9 | 10">Service shall be implemented for listed releases </condition>
    RDTCEDRBDN: category=REPORT_DTC_EXT_DATA_RECORD_BY_DTC_NUMBER  # <condition Cond_ID="Diagnostic_Bus_Interface" value="CAN | CAN-FD | Flexray | 100BASE-T1 Ethernet | 1000BASE-T1 Ethernet | MOST ">Which Bus interface is used as the main connector for diagnostic access to the ECU</condition> <condition Cond_ID="Diagnostic_Specification" value="2023-09">For ECUs implementing MBDS2023</condition> <condition Cond_ID="Variant" value="Application">ECU is running in application mode</condition> <condition Cond_ID="Fault_Memory" value="Yes | Yes with EE-Data">ECU implements Fault Memory for Production and Aftersales purposes and optionally integrates Engineering Environmental Data (E-E-Data)</condition> <condition Cond_ID="BROP_Level" value="1 | 2 | 3 | 4 | 5 | 6 | 7 | 8 | 9 | 10">Service shall be implemented for listed releases </condition>
    RDTCFDC: category=REPORT_DTC_FAULT_DETECTION_COUNTER  # <condition Cond_ID="Diagnostic_Bus_Interface" value="CAN | CAN-FD | Flexray | 100BASE-T1 Ethernet | 1000BASE-T1 Ethernet | MOST ">Which Bus interface is used as the main connector for diagnostic access to the ECU</condition> <condition Cond_ID="Diagnostic_Specification" value="2023-09">For ECUs implementing MBDS2023</condition> <condition Cond_ID="Variant" value="Application">ECU is running in application mode</condition> <condition Cond_ID="Fault_Memory" value="Yes | Yes with EE-Data">ECU implements Fault Memory for Production and Aftersales purposes and optionally integrates Engineering Environmental Data (E-E-Data)</condition> <condition Cond_ID="Debounce_Counter" value="Yes">If an ECU supports centralized de-bounce counters for fault maturation as described in ISO14229-1, it may report the fault maturation counters. If the Autosar Standard Software (DEM) is used, this feature will automatically be available when the de-bouncing option is selected.</condition> <condition Cond_ID="BROP_Level" value="4 | 5 | 6 | 7 | 8 | 9 | 10">Service shall be implemented for listed releases </condition>
    RDTCSSBDTC: category=REPORT_DTC_SNAPSHOT_RECORD_BY_DTC_NUMBER  # <condition Cond_ID="Diagnostic_Bus_Interface" value="CAN | CAN-FD | Flexray | 100BASE-T1 Ethernet | 1000BASE-T1 Ethernet | MOST ">Which Bus interface is used as the main connector for diagnostic access to the ECU</condition> <condition Cond_ID="Diagnostic_Specification" value="2023-09">For ECUs implementing MBDS2023</condition> <condition Cond_ID="Variant" value="Application">ECU is running in application mode</condition> <condition Cond_ID="Fault_Memory" value="Yes | Yes with EE-Data">ECU implements Fault Memory for Production and Aftersales purposes and optionally integrates Engineering Environmental Data (E-E-Data)</condition> <condition Cond_ID="BROP_Level" value="1 | 2 | 3 | 4 | 5 | 6 | 7 | 8 | 9 | 10">Service shall be implemented for listed releases </condition>
    RNODTCBSM: category=REPORT_NUMBER_OF_DTC_BY_STATUS_MASK  # <condition Cond_ID="Diagnostic_Bus_Interface" value="CAN | CAN-FD | Flexray | 100BASE-T1 Ethernet | 1000BASE-T1 Ethernet | MOST ">Which Bus interface is used as the main connector for diagnostic access to the ECU</condition> <condition Cond_ID="Diagnostic_Specification" value="2023-09">For ECUs implementing MBDS2023</condition> <condition Cond_ID="Variant" value="Application">ECU is running in application mode</condition> <condition Cond_ID="Fault_Memory" value="Yes | Yes with EE-Data">ECU implements Fault Memory for Production and Aftersales purposes and optionally integrates Engineering Environmental Data (E-E-Data)</condition> <condition Cond_ID="BROP_Level" value="1 | 2 | 3 | 4 | 5 | 6 | 7 | 8 | 9 | 10">Service shall be implemented for listed releases </condition>
    RSUPDTC: category=REPORT_SUPPORTED_DTC  # <condition Cond_ID="Diagnostic_Bus_Interface" value="CAN | CAN-FD | Flexray | 100BASE-T1 Ethernet | 1000BASE-T1 Ethernet | MOST ">Which Bus interface is used as the main connector for diagnostic access to the ECU</condition> <condition Cond_ID="Diagnostic_Specification" value="2023-09">For ECUs implementing MBDS2023</condition> <condition Cond_ID="Variant" value="Application">ECU is running in application mode</condition> <condition Cond_ID="Fault_Memory" value="Yes | Yes with EE-Data">ECU implements Fault Memory for Production and Aftersales purposes and optionally integrates Engineering Environmental Data (E-E-Data)</condition> <condition Cond_ID="BROP_Level" value="1 | 2 | 3 | 4 | 5 | 6 | 7 | 8 | 9 | 10">Service shall be implemented for listed releases </condition>
  diagnostic request download RequestDownload: access-permission=AP_All, request-download-class=RequestDownloadClass  # <OR> <condition Cond_ID="Diagnostic_Bus_Interface" value="CAN | CAN-FD | LIN | Flexray | 100BASE-T1 Ethernet | 1000BASE-T1 Ethernet | MOST ">Which Bus interface is used as the main connector for diagnostic access to the ECU</condition> <condition Cond_ID="Diagnostic_Specification" value="2023-09">For ECUs implementing MBDS2023</condition> <condition Cond_ID="Variant" value="Boot">ECU is running in boot mode</condition> <condition Cond_ID="N_o_flashable_SW_blocks" value="1|2|3|4|5|6|7|8|9|10|11|12|13|14|15|16|17|18|19|20|21|22|23|24|25|26|27|28|29|30|31|32|33|34|35|36|37|38|39|40|41|42|43|44|45|46|47|48|49|50|51|52|53|54|55|56|57|58|59|60|61|62|63|64|65|66|67|68|69|70|71|72|73|74|75|76|77|78|79|80|81|82|83|84|85|86|87|88|89|90|91|92|93|94|95|96|97|98|99|100|101|102|103|104|105|106|107|108|109|110|111|112|113|114|115|116|117|118|119|120|121|122|123|124|125|126|127|128">Number of flashable software blocks. If set to 0 = not flashable </condition> <condition Cond_ID="BROP_Level" value="1 | 2 | 3 | 4 | 5 | 6 | 7 | 8 | 9 | 10">Service shall be implemented for listed releases </condition> </OR><OR> <condition Cond_ID="Diagnostic_Bus_Interface" value="CAN | CAN-FD | LIN | Flexray | 100BASE-T1 Ethernet | 1000BASE-T1 Ethernet | MOST ">Which Bus interface is used as the main connector for diagnostic access to the ECU</condition> <condition Cond_ID="Diagnostic_Specification" value="2023-09">For ECUs implementing MBDS2023</condition> <condition Cond_ID="Variant" value="Application">ECU is running in application mode</condition> <condition Cond_ID="N_o_flashable_SW_blocks" value="1|2|3|4|5|6|7|8|9|10|11|12|13|14|15|16|17|18|19|20|21|22|23|24|25|26|27|28|29|30|31|32|33|34|35|36|37|38|39|40|41|42|43|44|45|46|47|48|49|50|51|52|53|54|55|56|57|58|59|60|61|62|63|64|65|66|67|68|69|70|71|72|73|74|75|76|77|78|79|80|81|82|83|84|85|86|87|88|89|90|91|92|93|94|95|96|97|98|99|100|101|102|103|104|105|106|107|108|109|110|111|112|113|114|115|116|117|118|119|120|121|122|123|124|125|126|127|128">Number of flashable software blocks. If set to 0 = not flashable </condition> <condition Cond_ID="BROP_Level" value="1 | 2 | 3 | 4 | 5 | 6 | 7 | 8 | 9 | 10">Service shall be implemented for listed releases </condition> <condition Cond_ID="ODX-Checker_settings" value="optional"></condition> </OR><OR> <condition Cond_ID="Diagnostic_Bus_Interface" value="CAN | CAN-FD | LIN | Flexray | 100BASE-T1 Ethernet | 1000BASE-T1 Ethernet | MOST ">Which Bus interface is used as the main connector for diagnostic access to the ECU</condition> <condition Cond_ID="Diagnostic_Specification" value="2023-09">For ECUs implementing MBDS2023</condition> <condition Cond_ID="Variant" value="Application">ECU is running in application mode</condition> <condition Cond_ID="OFR" value="OFR light | OFR full">ECU is able to be reprogrammed on the fly (OFR)</condition> <condition Cond_ID="BROP_Level" value="4 | 5 | 6 | 7 | 8 | 9 | 10">Service shall be implemented for listed releases </condition> </OR> <condition Cond_ID="ODX-Checker_settings" value="request_parameter | response_parameter">Check service for exact matching with template parameters</condition>
  diagnostic request file transfer File_Transfer_Read: access-permission=AP_All, request-file-transfer-class=RequestFileTransferClass  # <information Inf_ID="01">The File Transfer Read service is used by the external test tool to initiate a data transfer from the ECU to the external test tool to upload the specified file .</information> <condition Cond_ID="Diagnostic_Bus_Interface" value="CAN | CAN-FD | LIN | Flexray | 100BASE-T1 Ethernet | 1000BASE-T1 Ethernet | MOST ">Which Bus interface is used as the main connector for diagnostic access to the ECU</condition> <condition Cond_ID="Diagnostic_Specification" value="2023-09">For ECUs implementing MBDS2023</condition> <condition Cond_ID="Variant" value="Application">ECU is running in application mode</condition> <condition Cond_ID="Filesystem" value="Yes">ECU is reprogrammable and supports a file system</condition> <condition Cond_ID="BROP_Level" value="4 | 5 | 6 | 7 | 8 | 9 | 10">Service shall be implemented for listed releases </condition>
  diagnostic request upload SAR_Data_Request_Upload_SAR_Data_Nbr_1: access-permission=AP_All, request-upload-class=RequestUploadClass  # <condition Cond_ID="Diagnostic_Bus_Interface" value="CAN | CAN-FD | LIN | Flexray | 100BASE-T1 Ethernet | 1000BASE-T1 Ethernet | MOST ">Which Bus interface is used as the main connector for diagnostic access to the ECU</condition> <condition Cond_ID="Diagnostic_Specification" value="2023-09">For ECUs implementing MBDS2023</condition> <condition Cond_ID="Variant" value="Application">ECU is running in application mode</condition> <condition Cond_ID="SAR" value="Storing | Triggering and Storing">ECU is a storing or triggering SAR component</condition> <condition Cond_ID="BROP_Level" value="3 | 4 | 5 | 6 | 7 | 8 | 9 | 10">Service shall be implemented for listed releases </condition>
  5 x diagnostic routine control, all with access-permission=AP_All, routine-control-class=RoutineControlClass:
    Development_Fault_Memory: routine=Development_Fault_Memory  # <information Inf_ID="01"> The RID is used to read additional environmental data of a DTC, which are used for development purposes only. The additional environmental data are stored outside of the regular fault memory. Therefore they are not read using usual ReadDTCInformation diagnostic service. </information> <requirement Req_ID="01"> The number of Environmental Data and their content are individual for each ECU and DTC and are defined by the ECU developer. </requirement> <condition Cond_ID="Diagnostic_Bus_Interface" value="CAN | CAN-FD | Flexray | 100BASE-T1 Ethernet | 1000BASE-T1 Ethernet | MOST ">Which Bus interface is used as the main connector for diagnostic access to the ECU</condition> <condition Cond_ID="Diagnostic_Specification" value="2023-09">For ECUs implementing MBDS2023</condition> <condition Cond_ID="Variant" value="Application">ECU is running in application mode</condition> <condition Cond_ID="Development_Fault_Memory" value="Yes with EE-Data">The ECU supports DTCs that are relevant for development and analysis purposes only (located in the user-defined fault memory (Development Fault Memory)) and integrates Engineering Environmental Data (E-E-Data)</condition> <condition Cond_ID="BROP_Level" value="6 | 7 | 8 | 9 | 10">Service shall be implemented for listed releases </condition>
    Neu_Asynchronous_Routine: routine=Neu_Asynchronous_Routine
    Neu_Routine_Control: routine=Neu_Routine_Control
    Neu_Synchronous_Routine: routine=Neu_Synchronous_Routine
    SAR: routine=SAR  # <information Inf_ID="01"> The RID is used to clear all information stored in the SAR Memory.For details see component specific SAR specification. For more details contact RD/ICA, Team SAR.</information> <requirement Req_ID="01"> The RID shall be secured using a Security Access as specified in specification [DDS R01-01 DRECU]. </requirement> <requirement Req_ID="02"> The RoutineControl shall be used without routineControlOptions and shall not contain any routineStatusRecord in its response. </requirement> <condition Cond_ID="Diagnostic_Bus_Interface" value="CAN | CAN-FD | LIN | Flexray | 100BASE-T1 Ethernet | 1000BASE-T1 Ethernet | MOST ">Which Bus interface is used as the main connector for diagnostic access to the ECU</condition> <condition Cond_ID="Diagnostic_Specification" value="2023-09">For ECUs implementing MBDS2023</condition> <condition Cond_ID="Variant" value="Application">ECU is running in application mode</condition> <condition Cond_ID="SAR" value="Storing | Triggering and Storing">ECU is a storing or triggering SAR component</condition> <condition Cond_ID="BROP_Level" value="3 | 4 | 5 | 6 | 7 | 8 | 9 | 10">Service shall be implemented for listed releases </condition>
  diagnostic transfer exit File_Transfer_Stop: access-permission=AP_All, transfer-exit-class=TransferExitClass
  diagnostic write data by identifier New_Variant_Coding_1_Write: access-permission=AP_All, data-identifier=New_Variant_Coding_1, write-class=WriteDataByIdentifierClass
